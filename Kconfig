## Kconfig
```kconfig
config MT7697
	bool "MediaTek MT7697 support"
	default y
	---help---
	  MediaTek MT7697 chip.
	  Taken from mangoh/mangoh linux_drivers/

if MT7697

source "drivers/net/wireless/mt7697wifi/cp2130-driver/Kconfig"
source "drivers/net/wireless/mt7697wifi/mt7697q-driver/Kconfig"
source "drivers/net/wireless/mt7697wifi/mt7697serial-driver/Kconfig"

endif # MT7697
```

## cp2130-driver/Kconfig
```kconfig
config CP2130
	tristate "CP2130 USB-SPI Bridge"
	default y
	---help---
	  Linux kernel driver for Silicon Labs CP2130 USB-SPI Bridge
	  Taken from mangOH/cp2130 repo
```

## mt7697q-driver/Kconfig
```kconfig
config MT7697Q
	tristate "MT7697 queue"
	depends on CP2130
	default y
	---help---
	  Taken from mangoh/mangoh linux_drivers/
```

## mt7697serial-driver/Kconfig
```kconfig
config MT7697SERIAL
	tristate "mt7697 serial"
	default y
	---help---
	  Taken from mangOH/linux_kernel_modules/mt7697serial/
```

## mt7697wifi-driver/Kconfig
```kconfig
config MT7697WIFI
	tristate "MediaTek MT7697 wifi"
	depends on CFG80211
	depends on MT7697Q
	depends on MT7697SERIAL
	select CFG80211_WEXT_EXPORT
	select WIRELESS_EXT
	select WEXT_SPY
	select WEXT_PRIV
	select WEXT_CORE
	select WEXT_PROC
	default y
	---help---
	  Taken from mangoh/mangoh linux_drivers/
```
